## configs/yuzukihd_yuzukineko_nor_defconfig
```kconfig
# YuzukiNeko F101 NOR firmware image (Buildroot internal musl toolchain)
BR2_riscv=y
BR2_RISCV_ISA_RVC=y
BR2_RISCV_32=y
BR2_TOOLCHAIN_BUILDROOT_MUSL=y
BR2_PACKAGE_HOST_LINUX_HEADERS_CUSTOM_7_1=y
BR2_LINUX_KERNEL=y
BR2_LINUX_KERNEL_CUSTOM_GIT=y
BR2_LINUX_KERNEL_CUSTOM_REPO_URL="https://github.com/YuzukiHD/linux-mainline.git"
BR2_LINUX_KERNEL_CUSTOM_REPO_VERSION="sun252i_f101_7.2"
BR2_LINUX_KERNEL_USE_DEFCONFIG=y
BR2_LINUX_KERNEL_DEFCONFIG="sun252i_f101_yuzukineko"
BR2_LINUX_KERNEL_IMAGE=y
BR2_LINUX_KERNEL_DTS_SUPPORT=y
BR2_LINUX_KERNEL_INTREE_DTS_NAME="allwinner/sun252i-f101-yuzukineko"
BR2_TARGET_OPENSBI=y
BR2_TARGET_OPENSBI_CUSTOM_GIT=y
BR2_TARGET_OPENSBI_CUSTOM_REPO_URL="https://github.com/YuzukiHD/opensbi.git"
BR2_TARGET_OPENSBI_CUSTOM_REPO_VERSION="sun252i-f101"
BR2_TARGET_OPENSBI_PLAT="generic"
BR2_TARGET_OPENSBI_ADDITIONAL_VARIABLES="PLATFORM_DEFCONFIG=sun252i-f101.defconfig"
BR2_TARGET_OPENSBI_INSTALL_JUMP_IMG=y
# BR2_TARGET_OPENSBI_INSTALL_DYNAMIC_IMG is not set
BR2_ROOTFS_POST_IMAGE_SCRIPT="$(BR2_EXTERNAL_YUZUKIHD_PATH)/board/yuzukihd/yuzukineko/post-image-nor.sh"
BR2_TARGET_GENERIC_HOSTNAME="yuzukineko"
BR2_TARGET_GENERIC_GETTY_PORT="ttyS1"
BR2_TARGET_GENERIC_GETTY_BAUDRATE_115200=y
BR2_TARGET_ROOTFS_SQUASHFS=y
BR2_TARGET_ROOTFS_SQUASHFS4_XZ=y
# BR2_TARGET_ROOTFS_CPIO is not set
# BR2_TARGET_ROOTFS_TAR is not set
```

## configs/yuzukihd_yuzukineko_xuantie_defconfig
```kconfig
BR2_riscv=y
BR2_RISCV_ISA_RVC=y
BR2_RISCV_32=y
BR2_TOOLCHAIN_EXTERNAL=y
BR2_TOOLCHAIN_EXTERNAL_CUSTOM=y
BR2_TOOLCHAIN_EXTERNAL_DOWNLOAD=y
BR2_TOOLCHAIN_EXTERNAL_URL="https://occ-oss-prod.oss-cn-hangzhou.aliyuncs.com/resource//1755680614007/Xuantie-900-gcc-linux-6.6.0-musl32-x86_64-V3.2.0-20250627.tar.gz"
BR2_TOOLCHAIN_EXTERNAL_CUSTOM_PREFIX="riscv32-unknown-linux-musl"
BR2_TOOLCHAIN_EXTERNAL_GCC_14=y
BR2_TOOLCHAIN_EXTERNAL_HEADERS_6_6=y
BR2_TOOLCHAIN_EXTERNAL_CUSTOM_MUSL=y
BR2_TOOLCHAIN_EXTERNAL_CXX=y
BR2_TOOLCHAIN_EXTERNAL_OPENMP=y
BR2_TARGET_GENERIC_HOSTNAME="yuzukineko"
BR2_TARGET_GENERIC_GETTY_PORT="ttyS1"
BR2_TARGET_GENERIC_GETTY_BAUDRATE_115200=y
BR2_TARGET_ROOTFS_CPIO=y
# BR2_TARGET_ROOTFS_TAR is not set
```

## configs/yuzukihd_yuzukineko_xuantie_nor_defconfig
```kconfig
BR2_riscv=y
BR2_RISCV_ISA_RVC=y
BR2_RISCV_32=y
BR2_TOOLCHAIN_EXTERNAL=y
BR2_TOOLCHAIN_EXTERNAL_CUSTOM=y
BR2_TOOLCHAIN_EXTERNAL_DOWNLOAD=y
BR2_TOOLCHAIN_EXTERNAL_URL="https://occ-oss-prod.oss-cn-hangzhou.aliyuncs.com/resource//1755680614007/Xuantie-900-gcc-linux-6.6.0-musl32-x86_64-V3.2.0-20250627.tar.gz"
BR2_TOOLCHAIN_EXTERNAL_CUSTOM_PREFIX="riscv32-unknown-linux-musl"
BR2_TOOLCHAIN_EXTERNAL_GCC_14=y
BR2_TOOLCHAIN_EXTERNAL_HEADERS_6_6=y
BR2_TOOLCHAIN_EXTERNAL_CUSTOM_MUSL=y
BR2_TOOLCHAIN_EXTERNAL_CXX=y
BR2_TOOLCHAIN_EXTERNAL_OPENMP=y
BR2_TARGET_GENERIC_HOSTNAME="yuzukineko"
BR2_TARGET_GENERIC_GETTY_PORT="ttyS1"
BR2_TARGET_GENERIC_GETTY_BAUDRATE_115200=y
BR2_ROOTFS_OVERLAY="$(BR2_EXTERNAL_YUZUKIHD_PATH)/board/yuzukihd/yuzukineko/overlay"
BR2_ROOTFS_POST_IMAGE_SCRIPT="$(BR2_EXTERNAL_YUZUKIHD_PATH)/board/yuzukihd/yuzukineko/scripts/post-image-nor.sh"
BR2_ROOTFS_POST_IMAGE_SCRIPT_ARGS="--arch rv32"
BR2_LINUX_KERNEL=y
BR2_LINUX_KERNEL_CUSTOM_GIT=y
BR2_LINUX_KERNEL_CUSTOM_REPO_URL="https://github.com/YuzukiHD/linux-mainline.git"
BR2_LINUX_KERNEL_CUSTOM_REPO_VERSION="sun252i_f101_7.2"
BR2_LINUX_KERNEL_DEFCONFIG="sun252i_f101_yuzukineko"
BR2_LINUX_KERNEL_CONFIG_FRAGMENT_FILES="$(BR2_EXTERNAL_YUZUKIHD_PATH)/board/yuzukihd/yuzukineko/scripts/linux-nor.fragment"
BR2_LINUX_KERNEL_DTS_SUPPORT=y
BR2_LINUX_KERNEL_INTREE_DTS_NAME="allwinner/sun252i-f101-yuzukineko"
BR2_PACKAGE_BUSYBOX_CONFIG_FRAGMENT_FILES="$(BR2_EXTERNAL_YUZUKIHD_PATH)/board/yuzukihd/yuzukineko/scripts/busybox.fragment"
BR2_PACKAGE_MTD=y
BR2_PACKAGE_MTD_MKFSJFFS2=y
BR2_TARGET_ROOTFS_SQUASHFS=y
BR2_TARGET_ROOTFS_SQUASHFS4_XZ=y
# BR2_TARGET_ROOTFS_TAR is not set
BR2_TARGET_OPENSBI=y
BR2_TARGET_OPENSBI_CUSTOM_GIT=y
BR2_TARGET_OPENSBI_CUSTOM_REPO_URL="https://github.com/YuzukiHD/opensbi.git"
BR2_TARGET_OPENSBI_CUSTOM_REPO_VERSION="sun252i-f101"
BR2_TARGET_OPENSBI_PLAT="generic"
# BR2_TARGET_OPENSBI_INSTALL_DYNAMIC_IMG is not set
BR2_TARGET_OPENSBI_ADDITIONAL_VARIABLES="PLATFORM_DEFCONFIG=sun252i-f101.defconfig FW_JUMP_ADDR=0x40000000 FW_JUMP_FDT_ADDR=0x40f40000"
```
